## fs/jrnl_comp_ext4/Kconfig
```kconfig
# SPDX-License-Identifier: GPL-2.0-only
config JRNL_COMP_EXT4_FS
	depends on EXPERT
	tristate "The Extended 4 (jrnl_comp_ext4) filesystem"
	select BUFFER_HEAD
	select JRNL_COMP_JBD2
	select CRC16
	select CRC32
	select FS_IOMAP
	select FS_ENCRYPTION_ALGS if FS_ENCRYPTION
	help
	  This is the next generation of the ext3 filesystem.

	  Unlike the change from ext2 filesystem to ext3 filesystem,
	  the on-disk format of jrnl_comp_ext4 is not forwards compatible with
	  ext3; it is based on extent maps and it supports 48-bit
	  physical block numbers.  The jrnl_comp_ext4 filesystem also supports delayed
	  allocation, persistent preallocation, high resolution time stamps,
	  and a number of other features to improve performance and speed
	  up fsck time.  For more information, please see the web pages at
	  http://jrnl_comp_ext4.wiki.kernel.org.

	  The jrnl_comp_ext4 filesystem supports mounting an ext3 filesystem; while there
	  are some performance gains from the delayed allocation and inode
	  table readahead, the best performance gains require enabling jrnl_comp_ext4
	  features in the filesystem using tune2fs, or formatting a new
	  filesystem as an jrnl_comp_ext4 filesystem initially. Without explicit enabling
	  of jrnl_comp_ext4 features, the on disk filesystem format stays fully backward
	  compatible.

	  To compile this file system support as a module, choose M here. The
	  module will be called jrnl_comp_ext4.

	  If unsure, say N.

config JRNL_COMP_EXT4_USE_FOR_EXT2
	bool "Use jrnl_comp_ext4 for ext2 file systems"
	depends on JRNL_COMP_EXT4_FS
	depends on JRNL_COMP_EXT2_FS=n
	default y
	help
	  Allow the jrnl_comp_ext4 file system driver code to be used for ext2
	  file system mounts.  This allows users to reduce their
	  compiled kernel size by using one file system driver for
	  ext2, ext3, and jrnl_comp_ext4 file systems.

config JRNL_COMP_EXT4_FS_POSIX_ACL
	bool "Ext4 POSIX Access Control Lists"
	depends on JRNL_COMP_EXT4_FS
	select FS_POSIX_ACL
	help
	  POSIX Access Control Lists (ACLs) support permissions for users and
	  groups beyond the owner/group/world scheme.

	  If you don't know what Access Control Lists are, say N

config JRNL_COMP_EXT4_FS_SECURITY
	bool "Ext4 Security Labels"
	depends on JRNL_COMP_EXT4_FS
	help
	  Security labels support alternative access control models
	  implemented by security modules like SELinux.  This option
	  enables an extended attribute handler for file security
	  labels in the jrnl_comp_ext4 filesystem.

	  If you are not using a security module that requires using
	  extended attributes for file security labels, say N.

config JRNL_COMP_EXT4_DEBUG
	bool "Ext4 debugging support"
	depends on JRNL_COMP_EXT4_FS
	help
	  Enables run-time debugging support for the jrnl_comp_ext4 filesystem.

	  If you select Y here, then you will be able to turn on debugging
	  using dynamic debug control for mb_debug() / ext_debug() msgs.

config JRNL_COMP_EXT4_KUNIT_TESTS
	tristate "KUnit tests for jrnl_comp_ext4" if !KUNIT_ALL_TESTS
	depends on JRNL_COMP_EXT4_FS && KUNIT
	default KUNIT_ALL_TESTS
	help
	  This builds the jrnl_comp_ext4 KUnit tests.

	  KUnit tests run during boot and output the results to the debug log
	  in TAP format (https://testanything.org/). Only useful for kernel devs
	  running KUnit test harness and are not for inclusion into a production
	  build.

	  For more information on KUnit and unit tests in general please refer
	  to the KUnit documentation in Documentation/dev-tools/kunit/.

	  If unsure, say N.
```

## fs/jrnl_comp_jbd2/Kconfig
```kconfig
# SPDX-License-Identifier: GPL-2.0-only
config JRNL_COMP_JBD2
	tristate
	select CRC32
	help
	  This is a generic journaling layer for block devices that support
	  both 32-bit and 64-bit block numbers.  It is currently used by
	  the jrnl_comp_ext4 and OCFS2 filesystems, but it could also be used to add
	  journal support to other file systems or block devices such
	  as RAID or LVM.

	  If you are using jrnl_comp_ext4 or OCFS2, you need to say Y here.
	  If you are not using jrnl_comp_ext4 or OCFS2 then you will
	  probably want to say N.

	  To compile this device as a module, choose M here. The module will be
	  called jrnl_comp_jbd2.  If you are compiling jrnl_comp_ext4 or OCFS2 into the kernel,
	  you cannot compile this code as a module.

config JRNL_COMP_JBD2_DEBUG
	bool "JRNL_COMP_JBD2 (jrnl_comp_ext4) debugging support"
	depends on JRNL_COMP_JBD2
	help
	  If you are using the jrnl_comp_ext4 journaled file system (or
	  potentially any other filesystem/device using JRNL_COMP_JBD2), this option
	  allows you to enable debugging output while the system is running,
	  in order to help track down any problems you are having.
	  By default, the debugging output will be turned off.

	  If you select Y here, then you will be able to turn on debugging
	  with "echo N > /sys/module/jrnl_comp_jbd2/parameters/jrnl_comp_jbd2_debug", where N is a
	  number between 1 and 5. The higher the number, the more debugging
	  output is generated.  To turn debugging off again, do
	  "echo 0 > /sys/module/jrnl_comp_jbd2/parameters/jrnl_comp_jbd2_debug".

config JRNL_COMP_JBD2_INTERVAL_DIAG
	bool "JRNL_COMP_JBD2 paired interval diagnostic tracepoints"
	depends on JRNL_COMP_JBD2 && TRACING
	default n
	help
	  Explicit paired API, wait and flush intervals for journal attribution.
	  Tracepoints are disabled by default at runtime. Instrumented calls
	  may be nested and must not be summed without interval-union accounting.
	  Intended for controlled experiments, not a stable userspace ABI.
	  If unsure, say N.
```
